## boards/copyRenameBoard/Kconfig.copyRenameBoard
```kconfig
# Copyright (c) 2024 Nordic Semiconductor ASA
# SPDX-License-Identifier: Apache-2.0

config BOARD_COPYRENAMEBOARD
	select SOC_NRF54L15_CPUAPP if BOARD_COPYRENAMEBOARD_NRF54L15_CPUAPP || BOARD_COPYRENAMEBOARD_NRF54L15_CPUAPP_NS
```

## boards/copyRenameBoard/board.yml
```yaml
board:
  name: copyRenameBoard
  full_name: copy Rename Dummy Board 
  vendor: DummyTronics LTD
  socs:
    - name: nrf54l15
      variants:
        - name: ns
          cpucluster: cpuapp
runners:
  run_once:
    '--recover':
      - runners:
          - nrfjprog
          - nrfutil
        run: first
        groups:
          - boards:
              - copyRenameBoard
    '--erase':
      - runners:
          - nrfjprog
          - jlink
          - nrfutil
        run: first
        groups:
          - boards:
              - copyRenameBoard
    '--reset':
      - runners:
          - nrfjprog
          - jlink
          - nrfutil
        run: last
        groups:
          - boards:
              - copyRenameBoard
```

## boards/copyRenameBoard/copyRenameBoard_nrf54l15_cpuapp_defconfig
```kconfig
# Copyright (c) 2024 Nordic Semiconductor ASA
# SPDX-License-Identifier: Apache-2.0

CONFIG_SERIAL=y
CONFIG_CONSOLE=y
CONFIG_UART_CONSOLE=y
CONFIG_GPIO=y
CONFIG_ARM_MPU=y
```

## boards/fromScratchBoard/Kconfig.defconfig
```kconfig
# Copyright (c) 2024 Nordic Semiconductor ASA
# SPDX-License-Identifier: Apache-2.0

config HW_STACK_PROTECTION
	default ARCH_HAS_STACK_PROTECTION

if BOARD_FROMSCRATCHBOARD

config BOARD_FROMSCRATCHBOARD
	select SOC_NRF54L10_DEVELOP_IN_NRF54L15 if SOC_NRF54L10
	select SOC_NRF54L05_DEVELOP_IN_NRF54L15 if SOC_NRF54L05

config ROM_START_OFFSET
	default 0x800 if BOOTLOADER_MCUBOOT


endif # BOARD_FROMSCRATCHBOARD
```

## boards/fromScratchBoard/Kconfig.fromScratchBoard
```kconfig
# Copyright (c) 2024 Nordic Semiconductor ASA
# SPDX-License-Identifier: Apache-2.0

config BOARD_FROMSCRATCHBOARD
	select SOC_NRF54L15_CPUAPP if BOARD_FROMSCRATCHBOARD_NRF54L15_CPUAPP || BOARD_FROMSCRATCHBOARD_NRF54L15_CPUAPP_NS
```

## boards/fromScratchBoard/board.yml
```yaml
board:
  name: fromScratchBoard
  full_name: My New fromScratchBoard
  vendor: dummytronics
  socs:
    - name: nrf54l15
      variants:
        - name: ns
          cpucluster: cpuapp
runners:
  run_once:
    '--recover':
      - runners:
          - nrfjprog
          - nrfutil
        run: first
        groups:
          - boards:
              - fromScratchBoard
    '--erase':
      - runners:
          - nrfjprog
          - jlink
          - nrfutil
        run: first
        groups:
          - boards:
              - fromScratchBoard
    '--reset':
      - runners:
          - nrfjprog
          - jlink
          - nrfutil
        run: last
        groups:
          - boards:
              - fromScratchBoard
```

## dts/bindings/obled,driver.yaml
```yaml
description: Our simple GPIO on board LED (obled) dummy driver
compatible: "obled,driver"
include: base.yaml

properties:
  led-gpios:
    type: phandle-array
    required: true
    description: GPIO driving the LED of this instance
```
